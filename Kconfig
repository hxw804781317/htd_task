## Kconfig
```kconfig
rsource "./task/Kconfig"
rsource "./components/Kconfig"
rsource "./peripherals/Kconfig"
rsource "./external/Kconfig"
```

## components/htd_boot/Kconfig
```kconfig
menuconfig HTD_BOOT_ENABLE
    bool "htd bootloader enable."
    default n
    if HTD_BOOT_ENABLE
        config HTD_BOOT_IN_BOOTLOADER
            bool "This is a bootloader program?"
            default y
        config HTD_BOOTLOADER_SIZE
            hex "bootloader partition size."
            default 0x10000
        config HTD_BOOTLOADER_ADDR
            hex "bootloader partition address."
            default 0x8000000

        config HTD_BOOT_BANKA_ADDR
            hex "Bank A partition address"
            default 0x00
        config HTD_BOOT_BANKA_SIZE
            hex "Bank A partition size"
            default 0x10000
        config HTD_BOOT_BANKB_ADDR
            hex "BANK B partition address"
            default 0x00
        config HTD_BOOT_BANKB_SIZE
            hex "BANK B partition size"
            default 0x10000
        config HTD_BOOT_CONFIG_ADDR
            hex "bootloader config address"
            default 0x00
        config HTD_BOOT_CONFIG_SIZE
            hex "bootloader config partition size"
            default 0x8000
                    
        choice
            prompt "select boot overwrite method"
                default HTD_BOOT_OVERWRITE_COPY
            config HTD_BOOT_OVERWRITE_COPY
                bool "overwrite method: copy"
            config HTD_BOOT_OVERWRITE_SWAP
                bool "overwrite method: swap"
        endchoice 
    
        config HTD_BOOT_SUPPORT_UPDATE_DIFF
            depends on HTD_BOOT_IN_BOOTLOADER
            bool "Update method: diff"
            default n
        config HTD_BOOT_SUPPORT_COMPRESS_QUICKLZ
			select HTD_LIB_USE_QUICKLZ
            depends on HTD_BOOT_IN_BOOTLOADER
            bool "Update method: compress quicklz"
            default n
        config HTD_BOOT_SUPPORT_COMPRESS_FASTLZ
			select HTD_LIB_USE_FASTLZ
            depends on HTD_BOOT_IN_BOOTLOADER
            bool "Update method: compress fastlz"
            default n
            
        config HTD_BOOT_SUPPORT_SERIAL
            bool "Support Serial"
            default n
        config HTD_BOOT_SERIAL_NAME
            depends on HTD_BOOT_SUPPORT_SERIAL
            string "Serial name"
            default "uart1"
        config HTD_BOOT_SERIAL_TX_PINNUM
            depends on HTD_BOOT_SUPPORT_SERIAL
            hex "Serial tx pin-number"
            default 0x09
        config HTD_BOOT_SERIAL_RX_PINNUM
            depends on HTD_BOOT_SUPPORT_SERIAL
            hex "Serial rx pin-number"
            default 0x0A
        config HTD_BOOT_SERIAL_BAUDRATE
            depends on HTD_BOOT_SUPPORT_SERIAL
            int "Serial baudrate"
            default 115200
        config HTD_BOOT_SUPPORT_SERIAL_YMODEM
            depends on HTD_BOOT_SUPPORT_SERIAL
            bool "Serial Y-Modem Protocol"
            default y
    endif
```

## components/htd_elfdl/Kconfig
```kconfig
menuconfig HTD_ELFDL_ENABLE
    bool "elf dynamic load enable."
    select HTD_VFS_ENABLE
    default n
    
if HTD_ELFDL_ENABLE 
    choice
        prompt "select load mode"
            default ELFDL_LOAD_IN_SIMULATE
        config ELFDL_LOAD_IN_SIMULATE
            bool "Load Simulate"
        config ELFDL_LOAD_IN_RAM
            bool "Load RAM."
        config ELFDL_LOAD_IN_XIP
            bool "Load XIP."
    endchoice
endif
```

## components/htd_flash/Kconfig
```kconfig
menuconfig HTD_FLASH_UTILITY_BOX_ENABLE
    bool "flash ‌utility box enable"
    default n
    
if HTD_FLASH_UTILITY_BOX_ENABLE
    config HTD_FLASH_KV_ENABLE
        bool "flash kv enable"
        default n
    config HTD_FLASH_BOX_ENABLE
        bool "flash box enable"
        default n
    config HTD_FLASH_LOG_ENABLE
        bool "flash log enable"
        default n
    config HTD_FLASH_VAR_ENABLE
        bool "flash var enable"
        default n
endif
```

## components/htd_vfs/Kconfig
```kconfig
menuconfig HTD_VFS_ENABLE
    bool "htd_vfs: virtual file system."
    default y

if HTD_VFS_ENABLE
    config HTD_VFS_USING_NORFLASH_DEV
        select HTD_USING_NORFLASH
        bool "Using norflash driver api."
        default n
    config HTD_VFS_USING_NANDFLASH_DEV
        select HTD_USING_NANDFLASH
        bool "Using nandflash driver api."
        default n
    config HTD_VFS_USING_LIB_DHARA
        depends on (HTD_VFS_USING_NANDFLASH_DEV || HTD_VFS_USING_NORFLASH_DEV)
        bool "Using dhara lib(a small FTL designed to be used in resource-constrained systems for managing Nand/Nor flash)."
        default n
    config HTD_VFS_USING_SDCARD_DEV
        select HTD_USING_SDCARD
        bool "Using SD-Card driver api"
        default n
     
    config HTD_VFS_USING_POSIX
        bool "Using posix-like functions, open/read/write/close"
        default y
    config HTD_VFS_FD_MAX
        int "The maximal number of opened files."
        default 16

    config HTD_VFS_USING_ROMFS
        bool "Enable ReadOnly file system on flash."
        default n
    config HTD_VFS_USING_RAMFS
        bool "Enable RAM file system."
        default n
    config HTD_VFS_USING_SPIFFS
        bool "Enable SPIFFS file system."
        default n
        if HTD_VFS_USING_SPIFFS
            rsource "./lib/spiffs_Kconfig"
        endif
    config HTD_VFS_USING_ELM_FATFS
        bool "Enable elm-chan fatfs"
        default n
        if HTD_VFS_USING_ELM_FATFS
            rsource "./lib/fatfs_Kconfig"
        endif
    config HTD_VFS_USING_LITTLE_FS
        bool "Enable little-fs"
        default n
endif
```

## example/simulate/vs_sdl2_simulate/Kconfig
```kconfig
mainmenu "Configuration"
config SOC_SIMULATOR
    bool 
    default y

config BSP_USING_PC_SIMULATOR
    bool
    default y

rsource "../../../Kconfig"
```

## example/stm32xxx/stm32f072xx/Kconfig
```kconfig
mainmenu "Configuration"
config SOC_FAMILY_STM32
    bool 
    default n
config SOC_SERIES_STM32F0
    bool
    default n
config SOC_SERIES_STM32F072XX
    bool
    default n
    
config SOC_STM32F072XB
    bool
    select SOC_FAMILY_STM32
    select SOC_SERIES_STM32F0
    select SOC_SERIES_STM32F072XX
    select ARCH_ARM_CORTEX_M0
    default y

rsource "../../../Kconfig"
rsource "../../../mcu_sdk/stm32fxxx/stm32f072.Kconfig"
```

## example/stm32xxx/stm32f207xx/Kconfig
```kconfig
mainmenu "Configuration"
config SOC_FAMILY_STM32
    bool 
    default n
config SOC_SERIES_STM32F2
    bool
    default n
config SOC_SERIES_STM32F207XX
    bool
    default n
    
config SOC_STM32F207XC
    bool
    select SOC_FAMILY_STM32
    select SOC_SERIES_STM32F2
    select SOC_SERIES_STM32F207XX
    select ARCH_ARM_CORTEX_M3
    default y

rsource "../../../Kconfig"
rsource "../../../mcu_sdk/stm32fxxx/stm32f207.Kconfig"
```

## example/stm32xxx/stm32f303xx/Kconfig
```kconfig
mainmenu "Configuration"
config SOC_FAMILY_STM32
    bool 
    default n
config SOC_SERIES_STM32F3
    bool
    default n
config SOC_SERIES_STM32F303XX
    bool
    default n
    
config SOC_STM32F303XC
    bool
    select SOC_FAMILY_STM32
    select SOC_SERIES_STM32F3
    select SOC_SERIES_STM32F303XX
    select ARCH_ARM_CORTEX_M4
    select ARCH_ARM_CORTEX_FPU
    default y

rsource "../../../Kconfig"
rsource "../../../mcu_sdk/stm32fxxx/stm32f303.Kconfig"
```

## example/stm32xxx/stm32f401xx/Kconfig
```kconfig
mainmenu "Configuration"
config SOC_FAMILY_STM32
    bool 
    default y
config SOC_SERIES_STM32F4
    bool
    default y
config SOC_SERIES_STM32F401XX
    bool
    default y
    
config SOC_STM32F401xC 
    bool
    select ARCH_ARM_CORTEX_M4
    select ARCH_ARM_CORTEX_FPU
    default y

rsource "../../../Kconfig"
rsource "../../../mcu_sdk/stm32fxxx/stm32f401.Kconfig"
```

## example/stm32xxx/stm32f411xx-bootloader/Kconfig
```kconfig
mainmenu "Configuration"
config SOC_FAMILY_STM32
    bool 
    default y
config SOC_SERIES_STM32F4
    bool
    default y
config SOC_SERIES_STM32F411XX
    bool
    default y
    
config SOC_STM32F411xE
    bool
    select ARCH_ARM_CORTEX_M4
    select ARCH_ARM_CORTEX_FPU
    default y

rsource "../../../Kconfig"
rsource "../../../mcu_sdk/stm32fxxx/stm32f411.Kconfig"
```

## example/stm32xxx/stm32f730xx/Kconfig
```kconfig
mainmenu "Configuration"
config SOC_FAMILY_STM32
    bool 
    default n
config SOC_SERIES_STM32F7
    bool
    default n
config SOC_SERIES_STM32F730XX
    bool
    default n
    
config SOC_STM32F730X8
    bool
    select SOC_FAMILY_STM32
    select SOC_SERIES_STM32F7
    select SOC_SERIES_STM32F730XX
    select ARCH_ARM_CORTEX_M7
    select ARCH_ARM_CORTEX_FPU
    default y

rsource "../../../Kconfig"
rsource "../../../mcu_sdk/stm32fxxx/stm32f730.Kconfig"
```

## peripherals/Kconfig
```kconfig
menu "Hardware Drivers Config"
	rsource "./nandflash/Kconfig"
	rsource "./norflash/Kconfig"
	rsource "./eeprom/Kconfig"
    if !BSP_USING_PC_SIMULATOR
        rsource "./barometer/Kconfig"
        rsource "./imu_3axis_gsensor/Kconfig"
        rsource "./imu_6axis/Kconfig"
        rsource "./pixel_led/Kconfig"
        rsource "./sdcard/Kconfig"
        rsource "./network/Kconfig"
    endif
endmenu
```

## peripherals/barometer/Kconfig
```kconfig
config HTD_SENSOR_BAROMETER_BUS_I2C
    bool
    default n

menuconfig HTD_SENSOR_USING_BAROMETER
    bool "Enable barometer Sensor"
    select BSP_USING_I2CM
    default n
    if HTD_SENSOR_USING_BAROMETER
        choice
            prompt "select barometer chip"
                default HTD_BAROMETER_USING_SIMULATE
            config HTD_BAROMETER_USING_SIMULATE
                bool "Enable Simulate Sensor"
            config HTD_BAROMETER_USING_BMP085
                bool "Enable barometer BMP085"
                select HTD_SENSOR_BAROMETER_BUS_I2C
            config HTD_BAROMETER_USING_BMP180
                bool "Enable barometer BMP180"
                select HTD_SENSOR_BAROMETER_BUS_I2C
            config HTD_BAROMETER_USING_BMP280
                bool "Enable barometer BMP280"
                select HTD_SENSOR_BAROMETER_BUS_I2C
            config HTD_BAROMETER_USING_LQBP001MB
                bool "Enable barometer LQBP001MB"
                select HTD_SENSOR_BAROMETER_BUS_I2C
            config HTD_BAROMETER_USING_LQBP001TA
                bool "Enable barometer LQBP001TA"
                select HTD_SENSOR_BAROMETER_BUS_I2C
            config HTD_BAROMETER_USING_MSP2520R
                bool "Enable barometer MSP2520R"
                select HTD_SENSOR_BAROMETER_BUS_I2C 
        endchoice
        
        config HTD_BAROMETER_BUS_NAME
            string "barometer bus name"
            default "i2cm1"
        config HTD_BAROMETER_I2C_ADDR
            int "barometer i2c addr"
            depends on HTD_SENSOR_BAROMETER_BUS_I2C
            default 16
        config HTD_BAROMETER_I2C_PIN_SDA
            int "barometer i2c sda pin number."
            depends on HTD_SENSOR_BAROMETER_BUS_I2C
            default -1
        config HTD_BAROMETER_I2C_PIN_SCK
            int "barometer i2c sck pin number."
            depends on HTD_SENSOR_BAROMETER_BUS_I2C
            default -1
        config HTD_BAROMETER_POWER_PIN
            int "barometer power pin number"
            depends on (!HTD_BAROMETER_USING_SIMULATE)
            default -1
        config HTD_BAROMETER_POWER_PIN_ACTIVE_HIGH
            bool "power pin is high is power on"
            depends on (HTD_BAROMETER_POWER_PIN > 0)
            default y
    endif
```

## peripherals/eeprom/Kconfig
```kconfig
config HTD_EEPROM_BUS_I2C
    bool
    select BSP_USING_I2CM
    default n

config HTD_EEPROM_USING_AT24CXX
    bool
    default n
    
menuconfig HTD_USING_EEPROM
    bool "Enable eeprom"
    default n
	
if HTD_USING_EEPROM
	choice
		prompt "select EEPROM chip"
			default HTD_EEPROM_USING_SIMULATE
		config HTD_EEPROM_USING_SIMULATE
			bool "Enable EEPROM Simulate"
		config HTD_EEPROM_USING_AT24C01
			bool "Enable EEPROM AT24C01"
			select HTD_EEPROM_USING_AT24CXX
			select HTD_EEPROM_BUS_I2C
		config HTD_EEPROM_USING_AT24C02
			bool "Enable EEPROM AT24C02"
			select HTD_EEPROM_BUS_I2C
		config HTD_EEPROM_USING_AT24C04
			bool "Enable EEPROM AT24C04"
			select HTD_EEPROM_USING_AT24CXX
			select HTD_EEPROM_BUS_I2C
		config HTD_EEPROM_USING_AT24C08
			bool "Enable EEPROM AT24C08"
			select HTD_EEPROM_USING_AT24CXX
			select HTD_EEPROM_BUS_I2C
		config HTD_EEPROM_USING_AT24C16
			bool "Enable EEPROM AT24C16"
			select HTD_EEPROM_USING_AT24CXX
			select HTD_EEPROM_BUS_I2C
		config HTD_EEPROM_USING_AT24C32
			bool "Enable EEPROM AT24C32"
			select HTD_EEPROM_USING_AT24CXX
			select HTD_EEPROM_BUS_I2C
		config HTD_EEPROM_USING_AT24C64
			bool "Enable EEPROM AT24C64"
			select HTD_EEPROM_USING_AT24CXX
			select HTD_EEPROM_BUS_I2C
		config HTD_EEPROM_USING_AT24C128
			bool "Enable EEPROM AT24C128"
			select HTD_EEPROM_USING_AT24CXX
			select HTD_EEPROM_BUS_I2C
		config HTD_EEPROM_USING_AT24C256
			bool "Enable EEPROM AT24C256"
			select HTD_EEPROM_USING_AT24CXX
			select HTD_EEPROM_BUS_I2C
		config HTD_EEPROM_USING_AT24C512
			bool "Enable EEPROM AT24C512"
			select HTD_EEPROM_USING_AT24CXX
			select HTD_EEPROM_BUS_I2C
		config HTD_EEPROM_USING_AT24CM01
			bool "Enable EEPROM AT24CM01"
			select HTD_EEPROM_USING_AT24CXX
			select HTD_EEPROM_BUS_I2C
		config HTD_EEPROM_USING_AT24CM02
			bool "Enable EEPROM AT24CM02"
			select HTD_EEPROM_USING_AT24CXX
			select HTD_EEPROM_BUS_I2C
	endchoice

	config HTD_EEPROM_BUS_NAME
		string "eeprom bus name"
		depends on HTD_EEPROM_BUS_I2C
		default "i2cm1"
	config HTD_EEPROM_POWER_PIN
		int "eeprom power pin number"
		default -1
	config HTD_EEPROM_POWER_PIN_ACTIVE_HIGH
		bool "power pin is high is power on"
		depends on (HTD_EEPROM_POWER_PIN >= 0)
		default y   
	config HTD_EEPROM_I2C_ADDR
		hex "eeprom i2c addr"
		depends on HTD_EEPROM_BUS_I2C
		default 0xA0
	config HTD_EEPROM_I2C_PIN_SDA
		int "eeprom i2c sda pin number."
		depends on HTD_EEPROM_BUS_I2C
		default -1
	config HTD_EEPROM_I2C_PIN_SCK
		int "eeprom i2c sck pin number."
		depends on HTD_EEPROM_BUS_I2C
		default -1  
endif
```

## peripherals/imu_3axis_gsensor/Kconfig
```kconfig
config HTD_GSENSOR_BUS_I2C
    bool
    default n
	
menuconfig HTD_SENSOR_USING_GSENSOR
    bool "Enable G-Sensor(3-axis acceleromete)"
    select BSP_USING_I2CM
    default n
    if HTD_SENSOR_USING_GSENSOR
        choice
            prompt "select G-Sensor chip"
                default HTD_GSENSOR_USING_SIMULATE
            config HTD_GSENSOR_USING_SIMULATE
                bool "Enable G-Sensor Simulate"
            config HTD_GSENSOR_USING_SC7A20E
                bool "Enable G-Sensor sc7a20e"
                select HTD_GSENSOR_BUS_I2C
            config HTD_GSENSOR_USING_SC7A20H
                bool "Enable G-Sensor sc7a20h"
                select HTD_GSENSOR_BUS_I2C
            config HTD_GSENSOR_USING_STK8321
                bool "Enable G-Sensor stk8321"
                select HTD_GSENSOR_BUS_I2C
        endchoice
    
        config HTD_GSENSOR_BUS_NAME
            string "G-Sensor bus name"
            default "i2cm1" 
        config HTD_GSENSOR_I2C_ADDR
            hex "G-Sensor i2c addr"
            depends on HTD_GSENSOR_BUS_I2C
            default 0x36
        config HTD_GSENSOR_I2C_PIN_SDA
            int "G-Sensor i2c sda pin number."
            depends on HTD_GSENSOR_BUS_I2C
            default -1
        config HTD_GSENSOR_I2C_PIN_SCK
            int "G-Sensor i2c sck pin number."
            depends on HTD_GSENSOR_BUS_I2C
            default -1
        config HTD_GSENSOR_SAMPLE_FREQ
            int "G-Sensor sample freq"
            default 50
        config HTD_GSENSOR_INT_PIN
            int "G-Sensor interrupt pin number"
            default 129
        config HTD_GSENSOR_POWER_PIN
            int "G-Sensor power pin number"
            default -1
        config HTD_GSENSOR_POWER_PIN_ACTIVE_HIGH
            bool "power pin is high is power on"
            depends on (HTD_GSENSOR_POWER_PIN > 0)
            default y
    endif
```
