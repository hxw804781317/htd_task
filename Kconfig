## Kconfig
```kconfig
rsource "./task/Kconfig"
rsource "./components/Kconfig"
rsource "./external/Kconfig"
```

## components/Kconfig
```kconfig
menu "components config"
    #rsource "./htd_boot/Kconfig"
    rsource "./htd_console/Kconfig"
    rsource "./htd_button/Kconfig"
    rsource "./htd_led/Kconfig"
    #rsource "./htd_vfs/Kconfig"
endmenu
```

## components/htd_button/Kconfig
```kconfig
menuconfig HTD_BUTTON_ENABLE
    bool "htd button enable."
    default n
    if HTD_BUTTON_ENABLE
        config HTD_BUTTON_SUPPORT_MATRIX
            bool "support matrix-button."
            default n
        config BUTTON_MATRIX_SUPPORT_REPEAT
            depends on HTD_BUTTON_SUPPORT_MATRIX
            bool "matrix-button support repeat."
            default n
        config HTD_BUTTON_SUPPORT_CHARLIE
            bool "support charlie-button."
            default n
        config BUTTON_CHARLIE_SUPPORT_REPEAT
            depends on HTD_BUTTON_SUPPORT_CHARLIE
            bool "charlie-button support repeat."
            default n
    endif
```

## components/htd_console/Kconfig
```kconfig
menuconfig HTD_CONSOLE_ENABLE
    bool "htd console command enable."
    default y
    if HTD_CONSOLE_ENABLE
        config HTD_CONSOLE_NAME
            string "The console name"
            default "htd"
                    
        config HTD_CONSOLE_SUPPORT_CMD
            bool "support command input."
            default y
        config HTD_CONSOLE_SUPPORT_CMD_HISTORY
            depends on HTD_CONSOLE_SUPPORT_CMD
            bool "support command history"
            default y
        config HTD_CONSOLE_HISTORY_LINES
            depends on HTD_CONSOLE_SUPPORT_CMD_HISTORY
            int "The command history line number"
            range 3 32
            default 5
        config HTD_CONSOLE_CMD_SIZE
            depends on HTD_CONSOLE_SUPPORT_CMD_HISTORY
            int "The command line size for shell"
            range 32 256
            default 48
            
        config HTD_CONSOLE_SERIAL_NAME
            depends on HTD_TASK_ENABLE
            string "Serial name"
            default "uart1"
        config HTD_CONSOLE_SERIAL_TX_PINNUM
            depends on HTD_TASK_ENABLE
            hex "Serial tx pin-number"
            default 0x09
        config HTD_CONSOLE_SERIAL_RX_PINNUM
            depends on HTD_TASK_ENABLE
            hex "Serial rx pin-number"
            default 0x0A
        config HTD_CONSOLE_SERIAL_BAUDRATE
            depends on HTD_TASK_ENABLE
            int "Serial baudrate"
            default 115200
    endif
```

## components/htd_led/Kconfig
```kconfig
menuconfig HTD_LED_ENABLE
    bool "htd led enable."
    default n
    if HTD_LED_ENABLE
        config HTD_LED_SUPPORT_CHARLIE
            bool "support charlie-led."
            default n
        
        config HTD_LED_SUPPORT_MATRIX
            bool "support matrix-led."
            default n
			
		config HTD_LED_USE_HW_TIMER
            bool "led use hw-timer"
            default n
		config HTD_LED_HW_TIMER_NAME
			depends on HTD_LED_USE_HW_TIMER
			string "led hw-timer name"
			default "timer1"
    endif
```

## example/stm32xxx/stm32f103xx/Kconfig
```kconfig
mainmenu "Configuration"

config BSP_DIR
    string
    option env="BSP_ROOT"
    default "."

config SDK_DIR
    string
    option env="SDK_ROOT"
    default "../.."
    
config PKGS_DIR
    string
    option env="PKGS_ROOT"
    default "packages"

config SOC_FAMILY_STM32
    bool 
    default n
config SOC_SERIES_STM32F1
    bool
    default n
config SOC_SERIES_STM32F103XX
    bool
    default n
    
config SOC_STM32F103XB
    bool
    select SOC_FAMILY_STM32
    select SOC_SERIES_STM32F1
    select SOC_SERIES_STM32F103XX
    select ARCH_ARM_CORTEX_M3
    default y

rsource "../../../Kconfig"
rsource "../../../mcu_sdk/stm32fxxx/stm32f103.Kconfig"
```

## external/Kconfig
```kconfig
menu "external config"
    config HTD_LIB_USE_EASYTLV
        bool "easytlv enable."
        default n

    config HTD_LIB_USE_MICRO_ECC
        bool "micr-ecc enable"
        default n
        
    config HTD_LIB_USE_SDL2
        bool "sdl2 enable"
        default n
    
    config HTD_LIB_USE_SEGGER_RTT
        bool "SEGGER-RTT enable"
        default n
        
    config HTD_LIB_USE_FREERTOS
        bool "FreeRTOS enable"
        default n
endmenu
```

## task/Kconfig
```kconfig
menu "HTD-TASK"
    config HTD_TASK_ENABLE
        bool
        default y
    config HTD_TASK_WIN32_SDL2
    	depends on SOC_SIMULATOR
    	bool 
	default y
    choice
        depends on !HTD_TASK_WIN32_SDL2
        prompt "Select RTOS"
        default HTD_TASK_NONOS
        config HTD_TASK_NONOS
            bool "No RTOS"           
        config HTD_TASK_FREERTOS
            bool "FreeRTOS"      
    endchoice
    config HTD_TASK_THREAD_PRIORITY
        depends on !HTD_TASK_NONOS
        int "task thread priority."
        default 28
    config HTD_TASK_THREAD_STACK_SIZE
        depends on !HTD_TASK_NONOS
        int "task thread stack size."
        default 4096
        
    config HTD_MEMHEAP_FF_ENABLE
        bool "memheap ff enable"
        default y
    config HTD_MEMHEAP_SRAM_DEV_COUNT
		depends on HTD_MEMHEAP_FF_ENABLE
        int "memheap ram device count"
        default 2
    config HTD_MEMHEAP_FF_USE_TRACE
        depends on HTD_MEMHEAP_FF_ENABLE
        bool "memheap ff trace enable"
        default n
    
    config LIB_SEGGER_RTT_ENABLE
        bool "segger-rtt lib enable"
        default y
    config HTD_PRINTF_SUPPORT_FLOAT
        bool "printf-fmt support float"
        default n
    config HTD_MEM_USE_BYTELOOP
        bool "memcpy/memset use byte-loop"
        default n
    config HTD_VER_RELEASE
        bool "release version"
        default n
endmenu


config ARCH_CPU_64BIT
    bool
config ARCH_CPU_BIG_ENDIAN
    bool
config ARCH_ARM
    bool
config ARCH_ARM_CORTEX_M
    bool
    select ARCH_ARM
config ARCH_ARM_CORTEX_FPU
    bool
config ARCH_ARM_CORTEX_SECURE
    bool
config ARCH_ARM_CORTEX_M0
    bool
    select ARCH_ARM_CORTEX_M
config ARCH_ARM_CORTEX_M3
    bool
    select ARCH_ARM_CORTEX_M
config ARCH_ARM_MPU
    bool
    depends on ARCH_ARM
config ARCH_ARM_CORTEX_M4
    bool
    select ARCH_ARM_CORTEX_M
config ARCH_ARM_CORTEX_M7
    bool
    select ARCH_ARM_CORTEX_M
config ARCH_ARM_CORTEX_M33
    bool
    select ARCH_ARM_CORTEX_M
config ARCH_ARM_CORTEX_R
    bool
    select ARCH_ARM
config ARCH_ARM_MMU
    bool
    depends on ARCH_ARM
config ARCH_ARM_ARM9
    bool
    select ARCH_ARM
config ARCH_ARM_ARM11
    bool
    select ARCH_ARM
config ARCH_ARM_CORTEX_A
    bool
    select ARCH_ARM
config ARCH_ARM_CORTEX_A5
    bool
    select ARCH_ARM_CORTEX_A
config ARCH_ARM_CORTEX_A7
    bool
    select ARCH_ARM_CORTEX_A
config ARCH_ARM_CORTEX_A8
    bool
    select ARCH_ARM_CORTEX_A
config ARCH_ARM_CORTEX_A9
    bool
    select ARCH_ARM_CORTEX_A
config ARCH_ARMV8
    bool
config ARCH_MIPS
    bool
config ARCH_MIPS64
    bool
    select ARCH_CPU_64BIT
config ARCH_MIPS_XBURST
    bool
    select ARCH_MIPS
config ARCH_ANDES
    bool
config ARCH_CSKY
    bool
config ARCH_POWERPC
    bool
config ARCH_RISCV
    bool
config ARCH_RISCV_FPU
    bool
config ARCH_RISCV_FPU_S
    select ARCH_RISCV_FPU
    bool
config ARCH_RISCV_FPU_D
    select ARCH_RISCV_FPU
    bool
config ARCH_RISCV32
    select ARCH_RISCV
    bool
config ARCH_RISCV64
    select ARCH_RISCV
    select ARCH_CPU_64BIT
    bool
config ARCH_IA32
    bool
config ARCH_TIDSP
    bool
config ARCH_TIDSP_C28X
    bool
    select ARCH_TIDSP
    select ARCH_CPU_STACK_GROWS_UPWARD
config ARCH_HOST_SIMULATOR
    bool
config ARCH_CPU_STACK_GROWS_UPWARD
    bool
    default n
```
