## peripherals/imu_6axis/Kconfig
```kconfig
config HTD_6AXIS_BUS_I2C
    bool
    default n
	
menuconfig HTD_SENSOR_USING_6AXIS
    bool "Enable 6-AXIS(acceleromete+Gyroscope)"
    select BSP_USING_I2CM
    default n
    if HTD_SENSOR_USING_6AXIS
        choice
            prompt "select 6-AXIS chip"
                default HTD_6AXIS_USING_SIMULATE
            config HTD_6AXIS_USING_SIMULATE
                bool "Enable 6-AXIS Simulate"
            config HTD_6AXIS_USING_MPU6050
                bool "Enable 6-AXIS MPU6050"
                select HTD_6AXIS_BUS_I2C
        endchoice
    
        config HTD_6AXIS_BUS_NAME
            string "6-AXIS bus name"
            default "i2cm1" 
        config HTD_6AXIS_I2C_ADDR
            hex "6-AXIS i2c addr"
            depends on HTD_6AXIS_BUS_I2C
            default 0x36
        config HTD_6AXIS_I2C_PIN_SDA
            int "6-AXIS i2c sda pin number."
            depends on HTD_6AXIS_BUS_I2C
            default -1
        config HTD_6AXIS_I2C_PIN_SCK
            int "6-AXIS i2c sck pin number."
            depends on HTD_6AXIS_BUS_I2C
            default -1
        config HTD_6AXIS_SAMPLE_FREQ
            int "6-AXIS sample freq"
            default 50
        config HTD_6AXIS_INT_PIN
            int "6-AXIS interrupt pin number"
            default -1
        config HTD_6AXIS_POWER_PIN
            int "6-AXIS power pin number"
            default -1
        config HTD_6AXIS_POWER_PIN_ACTIVE_HIGH
            bool "power pin is high is power on"
            depends on (HTD_6AXIS_POWER_PIN > 0)
            default y
    endif
```

## peripherals/imu_9axis/Kconfig
```kconfig
menuconfig HTD_SENSOR_USING_9AXIS
    bool "Enable 9-AXIS(acceleromete+Gyroscope+Magnetometer)"
    default n
    if HTD_SENSOR_USING_9AXIS
        choice
            prompt "select 9-AXIS chip"
                default HTD_9AXIS_USING_SIMULATE
            config HTD_9AXIS_USING_SIMULATE
                bool "Enable 9-AXIS Simulate"
            config HTD_9AXIS_USING_MPU9250
                bool "Enable 9-AXIS MPU9250"
            config HTD_9AXIS_USING_ICM20948
                bool "Enable 9-AXIS ICM20948"
        endchoice
        choice
            prompt "select 9-AXIS bus i2c/spi"
                default HTD_9AXIS_BUS_SPI
            config HTD_9AXIS_BUS_SPI
                bool "9-AXIS bus use SPI"
                select BSP_USING_SPIM
            config HTD_9AXIS_BUS_I2C
                bool "9-AXIS bus use I2C"
                select BSP_USING_I2CM
        endchoice
        config HTD_9AXIS_BUS_NAME
            string "9-AXIS bus name"
            default "i2cm1"
            
        config HTD_9AXIS_I2C_ADDR
            hex "9-AXIS i2c addr"
            depends on HTD_9AXIS_BUS_I2C
            default 0x36
        config HTD_9AXIS_I2C_PIN_SDA
            int "9-AXIS i2c sda pin number."
            depends on HTD_9AXIS_BUS_I2C
            default -1
        config HTD_9AXIS_I2C_PIN_SCK
            int "9-AXIS i2c sck pin number."
            depends on HTD_9AXIS_BUS_I2C
            default -1
            
        config HTD_9AXIS_SPI_PIN_CS
            int "9-AXIS SPI CS pin number."
            depends on HTD_9AXIS_BUS_SPI
            default -1
        config HTD_9AXIS_SPI_PIN_SCK
            int "9-AXIS SPI SCK pin number."
            depends on HTD_9AXIS_BUS_SPI
            default -1
        config HTD_9AXIS_SPI_PIN_MOSI
            int "9-AXIS SPI MOSI pin number."
            depends on HTD_9AXIS_BUS_SPI
            default -1
        config HTD_9AXIS_SPI_PIN_MISO
            int "9-AXIS SPI MISO pin number."
            depends on HTD_9AXIS_BUS_SPI
            default -1
            
        config HTD_9AXIS_SAMPLE_FREQ
            int "9-AXIS sample freq"
            default 50
        config HTD_9AXIS_INT_PIN
            int "9-AXIS interrupt pin number"
            default -1
        config HTD_9AXIS_POWER_PIN
            int "9-AXIS power pin number"
            default -1
        config HTD_9AXIS_POWER_PIN_ACTIVE_HIGH
            bool "power pin is high is power on"
            depends on (HTD_9AXIS_POWER_PIN > 0)
            default y
    endif
```

## peripherals/nandflash/Kconfig
```kconfig
menuconfig HTD_USING_NANDFLASH
    bool "Enable nandflash"
    select BSP_USING_SPIM
    select BSP_USING_QSPIM
    default n
	
if HTD_USING_NANDFLASH
	config HTD_NANDFLASH_BUS_NAME
		string "nandflash bus name"
		default "spim1"
	config HTD_NANDFLASH_POWER_PIN
		int "nandflash power pin number"
		default -1
	config HTD_NANDFLASH_POWER_PIN_ACTIVE_HIGH
		bool "power pin is high is power on"
		depends on (HTD_NANDFLASH_POWER_PIN >= 0)
		default y 
	config HTD_NANDFLASH_PIN_CS
		int "nandflash cs pin number."
		default -1
	config HTD_NANDFLASH_PIN_SCK
		int "nandflash sck pin number."
		default -1
	config HTD_NANDFLASH_PIN_MOSI
		int "nandflash mosi pin number."
		default -1
	config HTD_NANDFLASH_PIN_MISO
		int "nandflash miso pin number."
		default -1
endif
```

## peripherals/network/Kconfig
```kconfig
config HTD_NETWORK_BUS_SPI
    bool
    default n

menuconfig HTD_USING_NETWORK_SENSOR
    bool "Enable network Sensor"
    select BSP_USING_SPIM
    default n
    if HTD_USING_NETWORK_SENSOR
        choice
            prompt "select network chip"
                default HTD_NETWORK_DEV_USING_SIMULATE
            config HTD_NETWORK_DEV_USING_SIMULATE
                bool "Enable Simulate Sensor"
            config HTD_NETWORK_DEV_USING_ENC28J60
                bool "Enable network device enc28j60"
                select HTD_NETWORK_BUS_SPI
        endchoice
        
        config HTD_NETWORK_BUS_NAME
            string "network bus name"
            default "spim1"
        config HTD_NETWORK_POWER_PIN
            int "network power pin number"
            default -1
        config HTD_NETWORK_POWER_PIN_ACTIVE_HIGH
            depends on (HTD_NETWORK_POWER_PIN > 0)
            bool "power pin is high is power on"
            default y 
        config HTD_NETWORK_RESET_PIN
            int "network reset pin number"
            default -1
        config HTD_NETWORK_INT_PIN
            int "network int pin number"
            default -1
        config NETWORK_DEV_SPI_PIN_CS
            depends on HTD_NETWORK_BUS_SPI
            int "network device SPI CS pin number."
            default 23
        config NETWORK_DEV_SPI_PIN_SCK
            depends on HTD_NETWORK_BUS_SPI
            int "network device SPI SCK pin number."
            default 24
        config NETWORK_DEV_SPI_PIN_MOSI
            depends on HTD_NETWORK_BUS_SPI
            int "network device SPI MOSI pin number."
            default 25
        config NETWORK_DEV_SPI_PIN_MISO
            depends on HTD_NETWORK_BUS_SPI
            int "network device SPI MISO pin number."
            default 26
        config NETWORK_DEV_PIN_CLK_OUT
            depends on HTD_NETWORK_BUS_SPI
            int "network device clock out pin number."
            default -1
    endif
    

if HTD_USING_NETWORK_SENSOR
    menu "network config"
        rsource "./lwip/Kconfig"
    endmenu
endif
```

## peripherals/network/lwip/Kconfig
```kconfig
menuconfig HTD_USING_LWIP
    bool "LWIP: light weight TCP/IP stack"
    default n
if HTD_USING_LWIP
    choice HTD_USING_LWIP_VERSION
        prompt "lwIP version"
        default HTD_USING_LWIP221
        help
            Select the lwIP version
        config HTD_USING_LWIP212
            bool "lwIP v2.1.2"
        config HTD_USING_LWIP221
            bool "lwIP v2.2.1"
    endchoice

    config HTD_USING_LWIP_VER_NUM
        hex
        default 0x20201    if HTD_USING_LWIP221
        default 0x20102    if HTD_USING_LWIP212
        default 0x10401    if HTD_USING_LWIP141

    if (HTD_USING_LWIP_VER_NUM >= 0x20000)
        config HTD_LWIP_IPV6
            bool "IPV6 protocol"
            default n
    endif

    config HTD_LWIP_MEM_ALIGNMENT
        int "Memory alignment"
        default 8 if ARCH_CPU_64BIT
        default 4

    config HTD_LWIP_RAW_PCB_NUM
        int "the number of RAW protocol control blocks"
        default 4
    config HTD_LWIP_UDP_PCB_NUM
        int "the number of UDP protocol control blocks"
        default 6
    config HTD_LWIP_TCP_PCB_NUM
        int "the number of TCP protocol control blocks"
        default 4
    
    config HTD_LWIP_RAW
        bool "RAW protocol"
        default n
    config HTD_LWIP_UDP
        bool "UDP protocol"
        default y
    config HTD_LWIP_TCP
        bool "TCP protocol"
        default y
    config HTD_LWIP_PPP
        bool "PPP protocol"
        default n
    config HTD_LWIP_IGMP
        bool "IGMP protocol"
        default n
    config HTD_LWIP_ICMP
        bool "ICMP protocol"
        default n
    config HTD_LWIP_SNMP
        bool "SNMP protocol"
        select HTD_LWIP_STATS
        default n
    config HTD_LWIP_DNS
        bool "DNS protocol"
        select HTD_LWIP_UDP
        default y
    config HTD_LWIP_STATS
        bool "Enable LWIP statistics"
        default n
    config HTD_LWIP_USER_HOOKS
        bool "Enable user-defined LWIP hooks"
        default n   
        
    config HTD_LWIP_USER_TLS
        bool "MBED-TLS"
        default n
    config HTD_LWIP_USER_HTTP
        bool "http server and client."
        select HTD_LWIP_TCP
        default n
    config HTD_LWIP_HTTP_USER_MAKE_FS
        bool "http user makefs"
        depends on HTD_LWIP_USER_HTTP
        default n
    config HTD_LWIP_USER_IPERF_SERVER
        bool "IPERF server"
        default n
    config HTD_LWIP_USER_MDNS
        bool "MDNS responder"
        default n
    config HTD_LWIP_USER_MQTT_CLIENT
        bool "MQTT client"
        default n
    config HTD_LWIP_USER_NETBIOS_SERVER
        bool "NetBiosns server"
        default n
    config HTD_LWIP_USER_SMTP_CLIENT
        bool "SMTP client"
        default n
    config HTD_LWIP_USER_SNMP
        bool "SNMP Agent"
        default n
    config HTD_LWIP_USER_SNTP_CLIENT
        bool "SNTP client"
        default n
    config HTD_LWIP_USER_TFTP_SERVER
        bool "TFTP server"
        default n
    
    choice HTD_USER_IP_ADDR_ASSIGNMENT
        prompt "IP address assignment."
        default HTD_LWIP_IP_ADDR_DHCP
        config HTD_LWIP_IP_ADDR_STATIC
            bool "IP Address Assignment use STATIC-IP"
        config HTD_LWIP_IP_ADDR_DHCP
            select HTD_LWIP_UDP
            bool "IP Address Assignment use DHCP"
        config HTD_LWIP_IP_ADDR_PPPOS
            select HTD_LWIP_PPP
            bool "IP Address Assignment use PPPoS"
        config HTD_LWIP_IP_ADDR_PPPOE
            select HTD_LWIP_PPP
            bool "IP Address Assignment use PPPoE"
    endchoice

    config IP_SOF_BROADCAST
        depends on HTD_LWIP_IP_ADDR_DHCP
        int "SOF broadcast"
        default 1
    config IP_SOF_BROADCAST_RECV
        depends on HTD_LWIP_IP_ADDR_DHCP
        int "SOF broadcast recv"
        default 1

    config HTD_LWIP_IPADDR
        string "IPv4: IP address"
        default "192.168.1.30"
    config HTD_LWIP_GWADDR
        string "IPv4: Gateway address"
        default "192.168.1.1"
    config HTD_LWIP_MSKADDR
        string "IPv4: Mask address"
        default "255.255.255.0"
endif
```

## peripherals/norflash/Kconfig
```kconfig
menuconfig HTD_USING_NORFLASH
    bool "Enable norflash"
    select BSP_USING_SPIM
    select BSP_USING_QSPIM
    default n
    if HTD_USING_NORFLASH
        config HTD_NORFLASH_BUS_NAME
            string "norflash bus name"
            default "spim1"
        config HTD_NORFLASH_POWER_PIN
            int "norflash power pin number"
            default -1
        config HTD_NORFLASH_POWER_PIN_ACTIVE_HIGH
            bool "power pin is high is power on"
			depends on (HTD_NORFLASH_POWER_PIN >= 0)
            default y 
        config HTD_NORFLASH_PIN_CS
            int "norflash cs pin number."
            default -1
        config HTD_NORFLASH_PIN_SCK
            int "norflash sck pin number."
            default -1
        config HTD_NORFLASH_PIN_MOSI
            int "norflash mosi pin number."
            default -1
        config HTD_NORFLASH_PIN_MISO
            int "norflash miso pin number."
            default -1
    endif
```

## peripherals/pixel_led/Kconfig
```kconfig
config HTD_PIXEL_LED_BUS_SPI
    bool
    select BSP_USING_SPIM
    default n
    
config HTD_PIXEL_LED_BUS_1WIRE
    bool
    default n
    
menuconfig HTD_USING_PIXEL_LED
    bool "Enable Pixel-LED"
    default n
    if HTD_USING_PIXEL_LED
        choice
            prompt "select Pixel-LED chip"
                default HTD_PIXEL_LED_USING_SIMULATE
            config HTD_PIXEL_LED_USING_SIMULATE
                bool "Enable Pixel-LED Simulate"
            config HTD_PIXEL_LED_USING_WS2812B
                bool "Enable Pixel-LED WS2812B"
                select HTD_PIXEL_LED_BUS_1WIRE
        endchoice
        config HTD_PIXEL_LED_COUNT
            int "Pixel-LED count"
            default 2
            
        config HTD_PIXEL_LED_1WIRE_PIN
            int "Pixel-LED 1Wire pin number."
            depends on HTD_PIXEL_LED_BUS_1WIRE
            default -1
        config HTD_PIXEL_LED_1WIRE_USE_PWM
            bool "use PWM simulate 1Wire"
            depends on HTD_PIXEL_LED_BUS_1WIRE
            select BSP_USING_PWM
            default n
        
        config HTD_PIXEL_LED_BUS_NAME
            string "Pixel-LED bus name"
            depends on (HTD_PIXEL_LED_BUS_SPI || HTD_PIXEL_LED_1WIRE_USE_PWM)
            default "spim1"
        config HTD_PIXEL_LED_SPI_PIN_SCK
            int "Pixel-LED spi sck pin number."
            depends on HTD_PIXEL_LED_BUS_SPI
            default -1
        config HTD_PIXEL_LED_SPI_PIN_MOSI
            int "Pixel-LED spi mosi pin number."
            depends on HTD_PIXEL_LED_BUS_SPI
            default -1  
    endif
```

## peripherals/sdcard/Kconfig
```kconfig
menuconfig HTD_USING_SDCARD
    bool "Enable sd-card"
    default n

if HTD_USING_SDCARD
	config HTD_SDCARD_BUS_NAME
		string "sd-card bus name"
		default "sdio1"
	config HTD_SDCARD_POWER_PIN
		int "sd-card power pin number"
		default -1
	config HTD_SDCARD_POWER_PIN_ACTIVE_HIGH
		bool "power pin is high(power on)."
		depends on (HTD_SDCARD_POWER_PIN >= 0)
		default y
	config HTD_SDCARD_DETECT_PIN
		int "sd-card detect pin number"
		default -1
	config HTD_SDCARD_DETECT_PIN_PLUG_HIGH
		bool "detect pin is high(plug-in)."
		depends on (HTD_SDCARD_DETECT_PIN >= 0)
		default n
	config HTD_SDCARD_PIN_CMD
		int "sd-card cmd pin number."
		default -1
	config HTD_SDCARD_PIN_SCK
		int "sd-card sck pin number."
		default -1
	config HTD_SDCARD_PIN_D0
		int "sd-card d0 pin number."
		default -1
	config HTD_SDCARD_PIN_D1
		int "sd-card d1 pin number."
		default -1
	config HTD_SDCARD_PIN_D2
		int "sd-card d2 pin number."
		default -1
	config HTD_SDCARD_PIN_D3
		int "sd-card d3 pin number."
		default -1
endif
```
